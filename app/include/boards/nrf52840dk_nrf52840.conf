## app/include/boards/nrf52840dk_nrf52840.conf
```kconfig
CONFIG_PM=y
CONFIG_PM_DEVICE=y
CONFIG_FLASH=y
CONFIG_FLASH_PAGE_LAYOUT=y
CONFIG_FLASH_MAP=y
CONFIG_SETTINGS=y
CONFIG_NVS=y
CONFIG_SETTINGS_NVS=y
CONFIG_BT_SETTINGS=y
```

## app/include/dts/bindings/mycompany,myapp.yaml
```yaml
description: Custom app node for battery sample
compatible: "mycompany,myapp"
properties:
  sample_interval_ms:
    type: int
  voltage_threshold_mv:
    type: int
  enable_ble:
    type: boolean
```
