## CMakeLists.txt
```
#
# Copyright (c) 2018 Nordic Semiconductor
#
# SPDX-License-Identifier: LicenseRef-Nordic-5-Clause
#
cmake_minimum_required(VERSION 3.20.0)

find_package(Zephyr REQUIRED HINTS $ENV{ZEPHYR_BASE})
project(fw_challenge)

# NORDIC SDK APP START
target_sources(app PRIVATE
  src/main.c
  src/adc_sampler.c
  src/buttons.c
  src/status_led.c
  src/app_events.c
  src/ble.c
  src/watchdog.c
)

target_include_directories(app PRIVATE
    ${CMAKE_CURRENT_SOURCE_DIR}/include
)

# zephyr_dts_bindings_path(dts/bindings)
# zephyr_add_dt_binding_path(dts)
# NORDIC SDK APP END
```

## Kconfig
```
#
# Copyright (c) 2018 Nordic Semiconductor
#
# SPDX-License-Identifier: LicenseRef-Nordic-5-Clause
#

source "Kconfig.zephyr"

menu "FW Challenge Options"

config APP_SAMPLE_INTERVAL_MS
		int "Sample interval (ms)"
		default 1000
		range 10 600000
		help
			Interval between ADC samples in milliseconds. Kept within 10 ms and 10 minutes.

config APP_ENABLE_BLE
		bool "Enable BLE features at boot"
		default y
		help
			When enabled, advertising can be started immediately at boot (subject to runtime toggles).

config APP_LED_ACTIVE_LOW
		bool "LED is active-low"
		default y
		help
			Select if the status LED GPIO is wired as active-low. If disabled, LED is treated as active-high.

endmenu

menu "FW Challenge Extras"

config APP_VOLTAGE_THRESHOLD_MV
	int "Voltage threshold (mV)"
	default 3000
	range 1000 6000
	help
	  Voltage threshold for notifications in millivolts. Kept within 1000 mV and 6000 mV.

config APP_BLE_DEVICE_NAME
	string "BLE device name"
	default "FW_Challenge"
	help
	  Bluetooth device name used in advertising data.

config APP_BUTTON_DEBOUNCE_DELAY_MS
	int "Button debounce delay (ms)"
	default 50
	range 10 1000
	help
	  Debounce delay for the button in milliseconds. Kept within 10 ms and 1 second.

config APP_LOG_LEVEL
	int "Application log level (0-4)"
	default 3
	range 0 4
	help
	  Log level for the application (0-4). 0: None, 1: Error, 2: Warning, 3: Info, 4: Debug.

endmenu

menu "FW Challenge System"

config APP_UNIT_TEST
		bool "Enable unit-test stubs in modules"
		default n
		help
			Internal option used by unit tests to stub hardware-heavy code paths
			(e.g., ADC/PM interactions) for fast, host-based testing.

config APP_ENABLE_PM
	bool "Enable power management (PM)"
	default y
	help
	  Enable Zephyr Power Management framework when supported by the SoC/board.
	  Used to suspend/resume the ADC device between samples.
	select PM if SYS_CLOCK_EXISTS && HAS_PM
	select PM_DEVICE if SYS_CLOCK_EXISTS && HAS_PM

config APP_ENABLE_SETTINGS
	bool "Enable Settings with NVS backend (if available)"
	default y
	help
	  Enable Zephyr Settings subsystem. If flash storage is available, NVS will
	  be selected as the backend to persist the sample counter.
	select SETTINGS

endmenu

menu "FW Challenge Watchdog"

config APP_WDT_ENABLE
	bool "Enable watchdog"
	default y
	select WATCHDOG
	help
	  Enable the hardware watchdog to reset the system if the app stops feeding it.

config APP_WDT_TIMEOUT_MS
	int "Watchdog timeout (ms)"
	default 8000
	range 100 60000
	depends on APP_WDT_ENABLE
	help
	  Watchdog timeout in milliseconds. The app will feed roughly at half this interval.

endmenu
```

## sample.yaml
```
sample:
  description: Bluetooth FW Challenge sample (custom BLE + ADC)
  name: FW Challenge
tests:
  sample.bluetooth.peripheral_lbs.unit_tests:
    build_only: false
    sysbuild: false
    platform_allow:
      - qemu_cortex_m3
    tags:
      - ztest
      - unit
    extra_args:
      - EXTRA_CONF_FILE=tests/prj.conf
    harness: ztest

  sample.bluetooth.peripheral_lbs.unit_tests:
    build_only: false
    sysbuild: false
    platform_allow:
      - native_posix
      - native_sim
    tags:
      - ztest
      - unit
    extra_args:
      - EXTRA_CONF_FILE=tests/prj.conf
    harness: ztest
```

## prj.conf
```kconfig
#
# Copyright (c) 2018 Nordic Semiconductor
#
# SPDX-License-Identifier: LicenseRef-Nordic-5-Clause
#
CONFIG_NCS_SAMPLES_DEFAULTS=y

CONFIG_BT=y
CONFIG_BT_PERIPHERAL=y
CONFIG_BT_DEVICE_NAME="FW-CHALLENGE"

# Enable the LBS service
# CONFIG_BT_LBS=y
# CONFIG_BT_LBS_POLL_BUTTON=y
CONFIG_DK_LIBRARY=y

CONFIG_SYSTEM_WORKQUEUE_STACK_SIZE=2048
CONFIG_LOG_DEFAULT_LEVEL=3
CONFIG_ADC=y
CONFIG_ADC_NRFX_SAADC=y
CONFIG_GPIO=y
CONFIG_ADC_LOG_LEVEL_DBG=n

# Enable PM (system and device) so we can suspend/resume ADC between samples
# Rely on board support; app Kconfig enables Settings (no backend forced here)\

# configurations to store counter value in nvs
CONFIG_FLASH=y 
CONFIG_FLASH_PAGE_LAYOUT=y
CONFIG_FLASH_MAP=y
CONFIG_SETTINGS=y
CONFIG_NVS=y
CONFIG_SETTINGS_NVS=y
CONFIG_BT_SETTINGS=y
```

## overlay-no-ble.conf
```kconfig
CONF_APP_ENABLE_BLE = n;
```

## src/main.c
```c
/*
 * Copyright (c) 2018 Nordic Semiconductor ASA
 *
 * SPDX-License-Identifier: LicenseRef-Nordic-5-Clause
 */

#include <zephyr/types.h>
#include <math.h>
#include <stddef.h>
#include <string.h>
#include <errno.h>
#include <zephyr/sys/printk.h>
#include <zephyr/kernel.h>

#include <zephyr/settings/settings.h>

#include "app.h"
#include "app_events.h"
#include "app_config.h"
#include "ble.h"

#include <zephyr/logging/log.h>

LOG_MODULE_REGISTER(APP, CONFIG_APP_LOG_LEVEL);

/* static bool app_button_state; */
static uint32_t sample_count;// count of successful battery voltage samples taken
/* settings key for persistent sample count */
static const char *const SAMPLE_COUNT_KEY = "app/sample_count"; /* settings key for persistent sample count */

/* BLE GATT and advertising are handled in ble.c */

#if IS_ENABLED(CONFIG_SETTINGS)
/* Settings load handler: called for keys under our subtree */
static int settings_set_handler(const char *key, size_t len, settings_read_cb read_cb, void *cb_arg)
{
	if (strcmp(key, "sample_count") == 0) {
		if (len != sizeof(sample_count)) {
			LOG_WRN("settings: unexpected size %zu for %s", len, key);
			return -EINVAL;
		}
		int rc = read_cb(cb_arg, &sample_count, sizeof(sample_count));
		if (rc >= 0) {
			LOG_INF("settings: loaded %s=%u", SAMPLE_COUNT_KEY, sample_count);
			return 0;
		}
		LOG_ERR("settings: read_cb failed (%d) for %s", rc, SAMPLE_COUNT_KEY);
		return rc;
	}
	return -ENOENT; /* key not handled */
}

/* Order is: get, set, commit, export */
SETTINGS_STATIC_HANDLER_DEFINE(app, "app", NULL, settings_set_handler, NULL, NULL);
#endif /* CONFIG_SETTINGS */

void sample_count_increment_and_save(void)
{
	sample_count++;
	if (IS_ENABLED(CONFIG_SETTINGS)) {
		int rc = settings_save_one(SAMPLE_COUNT_KEY, &sample_count, sizeof(sample_count));
		if (rc) {
			LOG_ERR("settings: save %s failed (%d)", SAMPLE_COUNT_KEY, rc);
		} else {
			LOG_INF("settings: saved %s=%u", SAMPLE_COUNT_KEY, sample_count);
		}
	}
}


int main(void)
{
	int err;

	LOG_INF("Starting FW-CHALLENGE\n");

	// Initialize the LED first so that we can use it to indicate failures
	// in other subsystems
	err = led_init();
	if (err) {
		LOG_ERR("LEDs init failed (err %d)\n", err);
		app_evt_raise(APP_ERR_LED);
		return 0;
	}

	// Initialize the button toggle BLE advertising
	err = button_init();
	if (err) {
		LOG_ERR("Button init failed (err %d)\n", err);
		app_evt_raise(APP_ERR_BUTTON);
		return 0;
	}

	/* Start watchdog (feeds periodically in background) */
	err = watchdog_init();
	if (err) {
		LOG_WRN("Watchdog init failed (%d)", err);
	}

	/* Initialize BLE stack and register GATT/service in ble.c */
	err = ble_init();
	if (err) {
		LOG_ERR("Bluetooth init failed (err %d)\n", err);
		app_evt_raise(APP_ERR_BLE);
		return 0;
	}

	if (IS_ENABLED(CONFIG_SETTINGS)) {
		err = settings_load();
		if (err) {
			LOG_ERR("settings: load failed (%d)", err);
		}
	}

	// Initialize the ADC for battery voltage measurement
	err = adc_init();
	if (err) {
		LOG_ERR("ADC init failed (err %d)\n", err);
		app_evt_raise(APP_ERR_ADC);
		return 0;
	}
	// Start BLE advertising if enabled and not already started
	ble_advertising_start();

}
```

## include/app.h
```c
/*
 * Copyright (c) 2018-2019 Peter Bigot Consulting, LLC
 *
 * SPDX-License-Identifier: Apache-2.0
 */
#ifndef ZEPHYR_INCLUDE_ADC_SAMPLER_H_
#define ZEPHYR_INCLUDE_ADC_SAMPLER_H_

#include <zephyr/kernel.h>
#include <zephyr/device.h>

extern bool en_ble;
extern uint16_t voltage_mv;
extern uint16_t sample_interval_ms;

extern struct k_work_delayable led_sample_work;
extern struct k_work_delayable led_error_work;
extern struct k_work_delayable battery_voltage_work;
extern struct k_work_delayable led_idle_work;

int adc_init(void);
int led_init(void);
int button_init(void);
void advertising_update(void);
void sample_count_increment_and_save(void);
int watchdog_init(void);


#endif /* ZEPHYR_INCLUDE_ADC_SAMPLER_H_ */
```

## include/app_events.h
```c
/*
 * Application event bits and API
 */

#ifndef APP_EVENTS_H_
#define APP_EVENTS_H_

#include <zephyr/kernel.h>
#include <zephyr/sys/atomic.h>

/* Event bits set in app_evt to indicate events and errors */
enum {
    APP_EVT_OK    = BIT(0),
    APP_ERR_LED   = BIT(1),
    APP_ERR_BUTTON= BIT(2),
    APP_ERR_ADC   = BIT(3),
    APP_ERR_BLE   = BIT(4),
};

#define APP_ERR_ANY (APP_ERR_LED | APP_ERR_BUTTON | APP_ERR_ADC | APP_ERR_BLE)

/* Global event bitmask (defined in a .c file) */
extern atomic_t app_evt_bits;

/* Helper to raise events and trigger app-level error handling */
void app_evt_raise(uint32_t bits);

/* Query if any bits in mask are set */
static inline bool app_evt_has(uint32_t mask)
{
    return (atomic_get(&app_evt_bits) & mask) != 0;
}

/* Clear specific event bits */
static inline void app_evt_clear(uint32_t bits)
{
    atomic_and(&app_evt_bits, ~bits);
}

#endif /* APP_EVENTS_H_ */
```

## include/app_uuids.h
```c
#ifndef APP_UUIDS_H__
#define APP_UUIDS_H__

/* Example UUIDs, replace with your own */
#define BT_UUID_CUSTOM_SERVICE_VAL \
  BT_UUID_128_ENCODE(0x12345678, 0x1234, 0x5678, 0x1234, 0x56789abcdef0)
#define BT_UUID_CUSTOM_SERVICE     BT_UUID_DECLARE_128(BT_UUID_CUSTOM_SERVICE_VAL)

#define BT_UUID_VOLTAGE_CHAR_VAL \
  BT_UUID_128_ENCODE(0x12345678, 0x1234, 0x5678, 0x1234, 0x56789abcdef1)
#define BT_UUID_VOLTAGE_CHAR      BT_UUID_DECLARE_128(BT_UUID_VOLTAGE_CHAR_VAL)

#define BT_UUID_SAMPLE_INTERVAL_CHAR_VAL \
  BT_UUID_128_ENCODE(0x12345678, 0x1234, 0x5678, 0x1234, 0x56789abcdef2)
#define BT_UUID_SAMPLE_INTERVAL_CHAR  BT_UUID_DECLARE_128(BT_UUID_SAMPLE_INTERVAL_CHAR_VAL)

#endif /* APP_UUIDS_H__ */
```

## include/ble.h
```c
/*
 * Minimal BLE API for this app
 */

#pragma once

#include <zephyr/types.h>

int ble_init(void);
void ble_advertising_start(void);
void notify_voltage(uint16_t mv);
```

## include/status_led.h
```c
#pragma once

#include <zephyr/kernel.h>
#include <zephyr/devicetree.h>
#include <stdbool.h>
#include <stdint.h>

/*
 * Status LED patterns:
 * - Idle/OK: slow blink (short ON, long OFF)
 * - Sampling: brief double-blink (one-shot overlay)
 * - Error: rapid blink (continuous until cleared) *
 * Thread-safe for typical single-core usage; all actions run in a dedicated workqueue and are non-blocking.
 */

#ifdef __cplusplus
extern "C" {
#endif

int led_init(void);

#ifdef __cplusplus
}
#endif
```

## src/adc_sampler.c
```c
/*
 * Copyright (c) 2020 Libre Solar Technologies GmbH
 *
 * SPDX-License-Identifier: Apache-2.0
 */

#include <inttypes.h>
#include <stddef.h>
#include <stdint.h>

#include <zephyr/device.h>
#include <zephyr/devicetree.h>
#include <zephyr/drivers/adc.h>
#include <zephyr/kernel.h>
#include <zephyr/sys/printk.h>
#include <zephyr/sys/util.h>
#include <zephyr/logging/log.h>
#include <zephyr/pm/device.h>
#include "app.h"
#include "app_events.h"
#include "ble.h"
// #include <nrfx_saadc.h>
/* #include <helpers/nrfx_gppi.h> */

LOG_MODULE_REGISTER(ADC_SAMPLER, CONFIG_ADC_LOG_LEVEL);

/* Global variables */
uint16_t voltage_mv = 0;
uint16_t sample_interval_ms = 0;

/* Prefer DT defaults first, then override with Kconfig values at init */
#if DT_NODE_EXISTS(DT_PATH(app)) && DT_NODE_HAS_PROP(DT_PATH(app), sample_interval_ms)
#define DT_SAMPLE_INTERVAL_MS DT_PROP(DT_PATH(app), sample_interval_ms)
#else
#define DT_SAMPLE_INTERVAL_MS 1000
#endif

#if DT_NODE_EXISTS(DT_PATH(app)) && DT_NODE_HAS_PROP(DT_PATH(app), voltage_threshold_mv)
#define DT_VOLTAGE_THRESHOLD_MV DT_PROP(DT_PATH(app), voltage_threshold_mv)
#else
#define DT_VOLTAGE_THRESHOLD_MV 3000
#endif

/* Effective threshold used at runtime */
static uint16_t voltage_threshold_mv = DT_VOLTAGE_THRESHOLD_MV;

#if !DT_NODE_EXISTS(DT_PATH(vbatt)) || \
	!DT_NODE_HAS_PROP(DT_PATH(vbatt), io_channels)
#error "No suitable devicetree overlay specified"
#endif

/* Local variables */
static uint16_t buf;

//declare a work item for sampling battery voltage 
struct k_work_delayable battery_voltage_work;
/* using adc_channel_setup_dt() to configure the ADC channel */
static const struct adc_dt_spec adc_ch = ADC_DT_SPEC_GET_BY_IDX(DT_NODELABEL(vbatt), 0);
/* Single ADC io-channel specified in devicetree (first entry). */

static struct adc_sequence sequence = {
	.buffer = &buf,
	/* buffer size in bytes, not number of samples */
	.buffer_size = sizeof(buf),
};

// Work function to measure battery voltage periodically with sample_interval_ms
void measure_battery_voltage(struct k_work *work)
{
	int err;
	int32_t val_mv;

	// Ensure the ADC device resumes before sampling when PM is enabled
	if (IS_ENABLED(CONFIG_PM_DEVICE)) {
		err = pm_device_action_run(adc_ch.dev, PM_DEVICE_ACTION_RESUME);
		if (err < 0) {
			LOG_ERR("Failed to resume ADC device (%d)", err);
		}
	}

	err = adc_read_dt(&adc_ch, &sequence);
	if (err < 0) {
		printk("Could not read (%d)", err);
		app_evt_raise(APP_ERR_ADC);
		return;
	}

	/* Convert raw sample to signed/unsigned as needed */
	if (adc_ch.channel_cfg.differential) {
		val_mv = (int32_t)((int16_t)buf);
	} else {
		val_mv = (int32_t)buf;
	}
	LOG_INF("raw=%"PRId32, val_mv);

	/* Convert raw value to millivolts using ADC instance config */
	err = adc_raw_to_millivolts_dt(&adc_ch, &val_mv);
	if (err < 0) {
		printk("Failed to convert to mV (%d)", err);
		app_evt_raise(APP_ERR_ADC);
		LOG_INF(" (mV N/A)\n");
	} else {
		voltage_mv = (uint16_t)val_mv;
		LOG_INF(", %"PRId32" mV\n", val_mv);
			notify_voltage((uint16_t)val_mv);
			/* Increment and persist the sample counter on successful measurements */
			sample_count_increment_and_save();
	}

	k_work_reschedule(&led_sample_work, K_NO_WAIT);// indicate a sample event by blinking the LED twice quickly

	/* Hook battery algorithm here if desired, e.g.:
		*   unsigned int pct = battery_level_pptt(val_mv, levels);
		*/

	if (val_mv < voltage_threshold_mv) {
		LOG_WRN("battery voltage: %d is below threshold\n",
				val_mv);
	}

	// Suspend the ADC device to save power until next sampling when PM is enabled
	if (IS_ENABLED(CONFIG_PM_DEVICE)) {
		err = pm_device_action_run(adc_ch.dev, PM_DEVICE_ACTION_SUSPEND);
		if (err < 0) {
			LOG_ERR("Failed to suspend ADC device (%d)", err);
		}
	}

	// Reschedule the work again after sample_interval_ms
	// Only if no error condition is present and notifications is enabled
	if (!app_evt_has(APP_ERR_ANY) && en_ble) 
	{
		k_work_reschedule(&battery_voltage_work, K_MSEC(sample_interval_ms));
	}
}

int adc_init(void)
{
	int err;

	/* Initialize from Devicetree first */
	sample_interval_ms = DT_SAMPLE_INTERVAL_MS;
	voltage_threshold_mv = DT_VOLTAGE_THRESHOLD_MV;

	/* Then apply Kconfig overrides (take precedence) */
#ifdef CONFIG_APP_SAMPLE_INTERVAL_MS
	sample_interval_ms = CONFIG_APP_SAMPLE_INTERVAL_MS;
#endif
#ifdef CONFIG_APP_VOLTAGE_THRESHOLD_MV
	voltage_threshold_mv = CONFIG_APP_VOLTAGE_THRESHOLD_MV;
#endif

	k_work_init_delayable(&battery_voltage_work, measure_battery_voltage);

	/* Configure the single ADC channel prior to sampling. */
	if (adc_is_ready_dt(&adc_ch) == false) {
		LOG_ERR("ADC device is not ready %s", adc_ch.dev->name);
		return 1;
	}

	err = adc_channel_setup_dt(&adc_ch);
	if (err < 0) {
		LOG_ERR("%s: device not ready (%d)", adc_ch.dev->name, err);
		return err;
	}

	// sequence.channels = BIT(adc_ch.channel_id);
	// sequence.resolution = adc_ch.resolution;
	// sequence.oversampling = adc_ch.oversampling;
	sequence.calibrate = true;	

	err = adc_sequence_init_dt(&adc_ch, &sequence);
	if (err < 0) {
		LOG_ERR("Failed to initialize ADC sequence (%d)", err);
		return err;
	}

	//take the first sample immediately
	k_work_reschedule(&battery_voltage_work, K_NO_WAIT);

	return 0;
}
```

## src/app_events.c
```c
/* Centralized application event handling */

#include <zephyr/kernel.h>
#include <zephyr/logging/log.h>
#include <zephyr/sys/atomic.h>
#include "app.h"
#include "app_events.h"

LOG_MODULE_REGISTER(APP_EVENTS, CONFIG_APP_LOG_LEVEL);

atomic_t app_evt_bits;

/* Work item that reacts to events (runs on system workqueue, non-blocking) */
static void app_evt_work_handler(struct k_work *work)
{
    /* Check for any error bits and react */
    uint32_t err = atomic_get(&app_evt_bits) & APP_ERR_ANY;
    if (err) {
        LOG_ERR("App error bits: 0x%08x", err);

        /* Stop periodic/status works promptly */
        k_work_cancel_delayable(&led_sample_work);
        k_work_cancel_delayable(&led_idle_work);
        k_work_cancel_delayable(&battery_voltage_work);

        if (!app_evt_has(APP_ERR_LED))//make sure there are no errors from initializing LEDs before trying to blink the LED
        {
            k_work_reschedule(&led_error_work, K_NO_WAIT); //trigger a quick blink of status LED to indicate error  
        }
    } else {
        /* No errors; ensure periodic works are running */
    }
}

static K_WORK_DEFINE(app_evt_work, app_evt_work_handler);

void app_evt_raise(uint32_t bits)
{
    /* Set/post the bits, then schedule handler work */
    atomic_or(&app_evt_bits, bits);

    /* Run the reaction asynchronously */
    k_work_submit(&app_evt_work);
}

/* Initialize event object early */
static int app_events_init(void)
{
    atomic_clear(&app_evt_bits);
    return 0;
}

SYS_INIT(app_events_init, POST_KERNEL, 0);
```

## src/ble.c
```c
#include <zephyr/bluetooth/bluetooth.h>
#include <zephyr/bluetooth/hci.h>
#include <zephyr/bluetooth/conn.h>
#include <zephyr/bluetooth/uuid.h>
#include <zephyr/bluetooth/gatt.h>
#include <zephyr/settings/settings.h>
#include <zephyr/kernel.h>

#include <zephyr/logging/log.h>
LOG_MODULE_REGISTER(BLE_MOD, CONFIG_APP_LOG_LEVEL);

#include "app.h"
#include "app_uuids.h"
#include "ble.h"
#include "app_events.h"

#define DEVICE_NAME             CONFIG_APP_BLE_DEVICE_NAME
#define DEVICE_NAME_LEN         (sizeof(DEVICE_NAME) - 1)

#define APP_NODE DT_PATH(app)
#define ENABLE_BLE DT_NODE_HAS_PROP(APP_NODE, enable_ble)



/* Index of the Voltage characteristic value attribute within custom_svc */
#define VOLTAGE_ATTR_IDX 2

bool en_ble = true;
static bool voltage_notify_enabled;

static void voltage_ccc_cfg_changed(const struct bt_gatt_attr *attr, uint16_t value)
{
    voltage_notify_enabled = (value == BT_GATT_CCC_NOTIFY);
}

static const struct bt_gatt_cpf voltage_cpf = {
    .format      = 0x06,            /* 16-bit unsigned int */
    .exponent    = -3,              /* milli */
    .unit        = 0x2728,
    .name_space  = 0x1,
    .description = 0,
};

static const struct bt_gatt_cpf sample_interval_cpf = {
    .format      = 0x06,
    .exponent    = -3,              /* milli */
    .unit        = 0x2703,
    .name_space  = 0x1,
    .description = 0,
};

/* Optional: Expose a read-only Service Name characteristic to help clients label the service. */
static const char service_name[] = "FW Challenge Service";

/* Locally declare a 128-bit UUID for the Service Name characteristic */
static struct bt_uuid_128 uuid_service_name = BT_UUID_INIT_128(
    0x12, 0x34, 0x56, 0x78, 0x90, 0xab, 0xcd, 0xef,
    0xfe, 0xdc, 0xba, 0x09, 0x87, 0x65, 0x43, 0x21);

static ssize_t read_service_name(struct bt_conn *conn, const struct bt_gatt_attr *attr,
                                 void *buf, uint16_t len, uint16_t offset)
{
    return bt_gatt_attr_read(conn, attr, buf, len, offset,
                             service_name, sizeof(service_name) - 1);
}

static ssize_t read_voltage(struct bt_conn *conn, const struct bt_gatt_attr *attr,
                            void *buf, uint16_t len, uint16_t offset)
{
    return bt_gatt_attr_read(conn, attr, buf, len, offset, &voltage_mv, sizeof(voltage_mv));
}

static ssize_t read_sample_interval(struct bt_conn *conn, const struct bt_gatt_attr *attr,
                                    void *buf, uint16_t len, uint16_t offset)
{
    return bt_gatt_attr_read(conn, attr, buf, len, offset, &sample_interval_ms, sizeof(sample_interval_ms));
}

BT_GATT_SERVICE_DEFINE(custom_svc,
    BT_GATT_PRIMARY_SERVICE(BT_UUID_CUSTOM_SERVICE),
    BT_GATT_CHARACTERISTIC(BT_UUID_VOLTAGE_CHAR,
                           BT_GATT_CHRC_READ | BT_GATT_CHRC_NOTIFY,
                           BT_GATT_PERM_READ,
                           read_voltage, NULL, &voltage_mv),
    BT_GATT_CUD("Voltage in mV", BT_GATT_PERM_READ),
    BT_GATT_CCC(voltage_ccc_cfg_changed, BT_GATT_PERM_READ | BT_GATT_PERM_WRITE),
    BT_GATT_CPF(&voltage_cpf),
    BT_GATT_CHARACTERISTIC(BT_UUID_SAMPLE_INTERVAL_CHAR,
                           BT_GATT_CHRC_READ,
                           BT_GATT_PERM_READ,
                           read_sample_interval, NULL, &sample_interval_ms),
    BT_GATT_CUD("Sample interval in ms", BT_GATT_PERM_READ),
    BT_GATT_CPF(&sample_interval_cpf),
    /* Read-only textual name to help clients identify the custom service */
    BT_GATT_CHARACTERISTIC(&uuid_service_name.uuid,
                           BT_GATT_CHRC_READ,
                           BT_GATT_PERM_READ,
                           read_service_name, NULL, NULL),
    BT_GATT_CUD("Service Name", BT_GATT_PERM_READ),
);

static const struct bt_data ad[] = {
    BT_DATA_BYTES(BT_DATA_FLAGS, (BT_LE_AD_GENERAL | BT_LE_AD_NO_BREDR)),
    BT_DATA(BT_DATA_NAME_COMPLETE, DEVICE_NAME, DEVICE_NAME_LEN),
};

/* Scan response: include the 128-bit service UUID and a small service-data payload with name */
static const uint8_t svc_data_payload[] = {
    /* 128-bit UUID in little-endian order must come first in service data */
    BT_UUID_CUSTOM_SERVICE_VAL,
    /* ASCII label (truncated to fit typical scan response space) */
    'F','W',' ','C','h','a','l','l','e','n','g','e'
};

static const struct bt_data sd[] = {
    BT_DATA_BYTES(BT_DATA_UUID128_ALL, BT_UUID_CUSTOM_SERVICE_VAL),
    BT_DATA(BT_DATA_SVC_DATA128, svc_data_payload, sizeof(svc_data_payload)),
};

static void connected(struct bt_conn *conn, uint8_t err)
{
    if (err) {
        LOG_ERR("Connection failed, err 0x%02x %s", err, bt_hci_err_to_str(err));
        return;
    }
    LOG_INF("Connected");
}

static void disconnected(struct bt_conn *conn, uint8_t reason)
{
    LOG_INF("Disconnected, reason 0x%02x %s", reason, bt_hci_err_to_str(reason));
}

static void recycled_cb(void)
{
    LOG_INF("Connection object available from previous conn. Disconnect is complete!");
    ble_advertising_start();
}

BT_CONN_CB_DEFINE(conn_callbacks) = {
    .connected        = connected,
    .disconnected     = disconnected,
    .recycled         = recycled_cb,
};

#if defined(CONFIG_APP_BLE_SECURITY_ENABLED)
static void auth_passkey_display(struct bt_conn *conn, unsigned int passkey)
{
    char addr[BT_ADDR_LE_STR_LEN];
    bt_addr_le_to_str(bt_conn_get_dst(conn), addr, sizeof(addr));
    LOG_INF("Passkey for %s: %06u", addr, passkey);
}

static void auth_cancel(struct bt_conn *conn)
{
    char addr[BT_ADDR_LE_STR_LEN];
    bt_addr_le_to_str(bt_conn_get_dst(conn), addr, sizeof(addr));
    LOG_INF("Pairing cancelled: %s", addr);
}

static void pairing_complete(struct bt_conn *conn, bool bonded)
{
    char addr[BT_ADDR_LE_STR_LEN];
    bt_addr_le_to_str(bt_conn_get_dst(conn), addr, sizeof(addr));
    LOG_INF("Pairing completed: %s, bonded: %d", addr, bonded);
}

static void pairing_failed(struct bt_conn *conn, enum bt_security_err reason)
{
    char addr[BT_ADDR_LE_STR_LEN];
    bt_addr_le_to_str(bt_conn_get_dst(conn), addr, sizeof(addr));
    LOG_ERR("Pairing failed conn: %s, reason %d %s", addr, reason, bt_security_err_to_str(reason));
}

static struct bt_conn_auth_cb conn_auth_callbacks = {
    .passkey_display = auth_passkey_display,
    .cancel = auth_cancel,
};

static struct bt_conn_auth_info_cb conn_auth_info_callbacks = {
    .pairing_complete = pairing_complete,
    .pairing_failed = pairing_failed
};
#endif

static struct k_work adv_work;

static void adv_work_handler(struct k_work *work)
{
    if (!en_ble) {
        (void)bt_le_adv_stop();
        LOG_INF("Advertising disabled by en_ble");
        return;
    }
    int err = bt_le_adv_start(BT_LE_ADV_CONN_FAST_2, ad, ARRAY_SIZE(ad), sd, ARRAY_SIZE(sd));
    if (err == -EALREADY) {
        LOG_DBG("Advertising already running");
        return;
    }
    if (err) {
        app_evt_raise(APP_ERR_BLE);
        LOG_ERR("Advertising failed to start (err %d)", err);
        return;
    }
    LOG_INF("Advertising started");
}

void ble_advertising_start(void)
{
    k_work_submit(&adv_work);
}

void notify_voltage(uint16_t mv)
{
    voltage_mv = mv;
    if (!voltage_notify_enabled) {
        return;
    }
    (void)bt_gatt_notify(NULL, &custom_svc.attrs[VOLTAGE_ATTR_IDX], &voltage_mv, sizeof(voltage_mv));
}

int ble_init(void)
{
    en_ble = DT_NODE_HAS_PROP(APP_NODE, enable_ble);// get the devicetree value
    en_ble = IS_ENABLED(CONFIG_APP_ENABLE_BLE);// get the Kconfig value. This is the final value to use
    // Initialize the Bluetooth Subsystem when enabled by DT
#if ENABLE_BLE
    int err = bt_enable(NULL);
    if (err) {
        app_evt_raise(APP_ERR_BLE);
        LOG_ERR("Bluetooth init failed (err %d)", err);
        return err;
    }
    /* Set device name from Kconfig option (non-persistent) */
    (void)bt_set_name(DEVICE_NAME);
#if defined(CONFIG_APP_BLE_SECURITY_ENABLED)
    err = bt_conn_auth_cb_register(&conn_auth_callbacks);
    if (err) {
        LOG_ERR("Failed to register authorization callbacks");
        return err;
    }
    err = bt_conn_auth_info_cb_register(&conn_auth_info_callbacks);
    if (err) {
        LOG_ERR("Failed to register authorization info callbacks");
        return err;
    }
#endif
    k_work_init(&adv_work, adv_work_handler);
    LOG_INF("Bluetooth initialized");
#endif
    return 0;
}
```

## src/buttons.c
```c
#include <zephyr/drivers/gpio.h>
#include <zephyr/kernel.h>
#include "app.h"
#include <zephyr/logging/log.h>
#include "app_events.h"

LOG_MODULE_REGISTER(BUTTONS, CONFIG_APP_LOG_LEVEL);

#define MIN_BUTTON_DEBOUNCE_TIME_MS CONFIG_APP_BUTTON_DEBOUNCE_DELAY_MS
#define TIME_TO_TRIGGGER_ERROR_STATE_MS 2000

struct k_work_delayable button0_reset_work;

static bool button0_is_pressed = true;

#if DT_NODE_EXISTS(DT_ALIAS(btn-user))
#define BUTTON0 DT_ALIAS(btn-user)
#elif DT_NODE_EXISTS(DT_ALIAS(button0))
#define BUTTON0 DT_ALIAS(button0)
#elif DT_NODE_EXISTS(DT_NODELABEL(btn-user))
#define BUTTON0 DT_NODELABEL(btn-user)
#elif DT_NODE_EXISTS(DT_NODELABEL(button0))
#define BUTTON0 DT_NODELABEL(button0)
#else
#define BUTTON0 DT_INVALID_NODE
#endif

#if DT_NODE_EXISTS(BUTTON0)
#define BUTTON0_DEV DT_PHANDLE(BUTTON0, gpios)
#define BUTTON0_PIN DT_PHA(BUTTON0, gpios, pin)
#define BUTTON0_FLAGS DT_PHA(BUTTON0, gpios, flags)

static const struct device *button0_dev = DEVICE_DT_GET(BUTTON0_DEV);
// static void adv_update_work_handler(struct k_work *work)
// {
// 	advertising_update();
// }
// static K_WORK_DEFINE(adv_update_work, adv_update_work_handler);

static void button0_cb(const struct device *port, struct gpio_callback *cb,
                       gpio_port_pins_t pins)
{
    static uint32_t prev_pres = 0;
	//static bool is_pressed = true;
	uint32_t elapsed_time = 0;

    // Button is configured to interrupt on both edges, so this callback will be called
    // twice for each press. We determine whether it was a press or release by tracking
	if(button0_is_pressed)
	{
	// Button was pressed down now register the time and set the flag
		button0_is_pressed = false;
		prev_pres = k_uptime_get_32();// get uptime in milliseconds

		//Just in case the either press or release event is missed or not registered
		//This will reset the button state after 4 seconds
		k_work_reschedule(&button0_reset_work, K_SECONDS(4));
	}
	else{
        // Button was released now calculate the elapsed time and if it is more than debounce time
        // consider it as a valid press
		button0_is_pressed = true;

		elapsed_time = k_uptime_get_32() - prev_pres;

		if(elapsed_time > TIME_TO_TRIGGGER_ERROR_STATE_MS) //use for demoing error state led pattern. This has no functional purpose
		{
			app_evt_raise(APP_ERR_BUTTON);
		}
		else if(elapsed_time > MIN_BUTTON_DEBOUNCE_TIME_MS) //debouncing
		{
			// toggle the ble enable/disable flag
			en_ble = !en_ble;
			LOG_INF("Advertising toggle button: %s\n", en_ble?"ENABLED":"DISABLED");

			// only if sampling work is battery sample task is not running
			// Restart sampling work immediately
			if(k_work_delayable_busy_get(&battery_voltage_work) == 0) 
			{
				k_work_reschedule(&battery_voltage_work, K_NO_WAIT);
			}
        }
		else{}
	}
}
#endif /* BUTTON0 */

static void button0_reset(struct k_work *work)
{
	button0_is_pressed = true;
	//printk("new threshold value is... %d\n",threshold_do_f16 );
}

int button_init()
{
	int err;
#if DT_NODE_EXISTS(BUTTON0)

	err = gpio_pin_configure(button0_dev, BUTTON0_PIN,
				 BUTTON0_FLAGS | GPIO_INPUT);
	if (err) {
		return err;
	}

	static struct gpio_callback gpio_cb0;

	err = gpio_pin_interrupt_configure(button0_dev, BUTTON0_PIN,
					   GPIO_INT_EDGE_BOTH);
	if (err) {
		return err;
	}

	gpio_init_callback(&gpio_cb0, button0_cb, BIT(BUTTON0_PIN));
	gpio_add_callback(button0_dev, &gpio_cb0);

#else
	LOG_ERR("WARNING: Buttons not supported on this board.\n");
#endif

    k_work_init_delayable(&button0_reset_work, button0_reset);

	return 0;
}
```

## src/status_led.c
```c
#include <zephyr/logging/log.h>
LOG_MODULE_REGISTER(STATUS_LED, CONFIG_APP_LOG_LEVEL);
#include <zephyr/drivers/gpio.h>
#include <zephyr/kernel.h>
#include "app.h"
#include "app_events.h"

struct k_work_delayable led_idle_work;
struct k_work_delayable led_sample_work;
struct k_work_delayable led_error_work;

/* Locate led0 as alias or label by that name for paired status*/
#if DT_NODE_EXISTS(DT_ALIAS(led0))
#define LED0 DT_ALIAS(led0)
#elif DT_NODE_EXISTS(DT_ALIAS(led-status))
#define LED0 DT_ALIAS(led-status)
#elif DT_NODE_EXISTS(DT_NODELABEL(led0))
#define LED0 DT_NODELABEL(led0)
#elif DT_NODE_EXISTS(DT_NODELABEL(led-status))
#define LED0 DT_NODELABEL(led-status)
#else
#define LED0 DT_INVALID_NODE
#endif

K_MUTEX_DEFINE(led_mutex);

#if DT_NODE_EXISTS(LED0)
#define LED0_DEV DT_PHANDLE(LED0, gpios)
#define LED0_PIN DT_PHA(LED0, gpios, pin)
#define LED0_FLAGS DT_PHA(LED0, gpios, flags)

static const struct device *led0_dev = DEVICE_DT_GET(LED0_DEV);
#endif /* LED0 */

//work handlers for different LED blink patterns 
//Blink patterns indicate different operation modes
//Idle mode - single short blink every sample_interval_ms/2
//Sample mode - double short blink every sample_interval_ms/2
//Error mode - fast continuous blink

//This work is independent of sample and error work, so it can be scheduled anytime
static void idle_work(struct k_work *work)
{
    //Lock the mutex to prevent simultaneous access to the LED from different work items
	k_mutex_lock(&led_mutex, K_FOREVER);
    //blink the LED once
    gpio_pin_set(led0_dev, LED0_PIN, 1);
    k_sleep(K_MSEC(50));
    gpio_pin_set(led0_dev, LED0_PIN, 0);
    k_mutex_unlock(&led_mutex);// release the mutex
    
    //reschedule the idle work to run again after sample_interval_ms/2
    k_work_reschedule(&led_idle_work, K_MSEC(sample_interval_ms/2));
}

//This work is scheduled when a sample is taken
//It blinks the LED twice quickly to indicate a sample event. It does not reschedule itself
static void sample_work(struct k_work *work)
{
    //Lock the mutex to prevent simultaneous access to the LED from different work items
    k_mutex_lock(&led_mutex, K_FOREVER);
	gpio_pin_set(led0_dev, LED0_PIN, 1);
    k_sleep(K_MSEC(50));
    gpio_pin_set(led0_dev, LED0_PIN, 0);
    k_sleep(K_MSEC(50));
    gpio_pin_set(led0_dev, LED0_PIN, 1);
    k_sleep(K_MSEC(50));
    gpio_pin_set(led0_dev, LED0_PIN, 0);
    k_mutex_unlock(&led_mutex);// release the mutex
	//printk("new threshold value is... %d\n",threshold_do_f16 );
    
}

//This work is scheduled when an error condition is detected
//It blinks the LED continuously at a fast rate to indicate an error condition. It reschedules itself
//It also cancels the other two work items to prevent interference as error indication is critical unless reset
static void error_work(struct k_work *work)
{
	gpio_pin_toggle(led0_dev, LED0_PIN);
	//printk("new threshold value is... %d\n",threshold_do_f16 );
    k_work_reschedule(&led_error_work, K_MSEC(100));
}

int led_init(void)
{
	int err = 0;
    k_work_init_delayable(&led_idle_work, idle_work);
    k_work_init_delayable(&led_sample_work, sample_work);
    k_work_init_delayable(&led_error_work, error_work);

#if DT_NODE_EXISTS(LED0)
	if(!device_is_ready(led0_dev)) 
	{
		return -ENODEV;
	}
    
    // Set the LED pin as output, initially off
    // derive the flags based on active low or active high configuration
    gpio_flags_t flags = LED0_FLAGS | GPIO_OUTPUT_INACTIVE;
    if (IS_ENABLED(CONFIG_APP_LED_ACTIVE_LOW)) 
    { 
        flags |= GPIO_ACTIVE_LOW; 
    }
    else
    {
        flags |= GPIO_ACTIVE_HIGH;
    }

    err = gpio_pin_configure(led0_dev, LED0_PIN, flags);
    if (err) {
        return err;
    }

    k_work_reschedule(&led_idle_work, K_NO_WAIT); //start the idle blink work
#endif
return err;
}
```

## src/watchdog.c
```c
#include <zephyr/kernel.h>
#include <zephyr/device.h>
#if IS_ENABLED(CONFIG_WATCHDOG)
#include <zephyr/drivers/watchdog.h>
#endif
#include <zephyr/logging/log.h>
LOG_MODULE_REGISTER(APP_WDT, CONFIG_APP_LOG_LEVEL);

#if IS_ENABLED(CONFIG_APP_WDT_ENABLE) && IS_ENABLED(CONFIG_WATCHDOG)

/* Pick the first watchdog by chosen or alias; fallback to DT_NODELABEL(wdt0) */
#if DT_HAS_CHOSEN(zephyr_watchdog)
#define WDT_NODE DT_CHOSEN(zephyr_watchdog)
#elif DT_NODE_EXISTS(DT_ALIAS(watchdog0))
#define WDT_NODE DT_ALIAS(watchdog0)
#elif DT_NODE_EXISTS(DT_NODELABEL(wdt0))
#define WDT_NODE DT_NODELABEL(wdt0)
#else
#define WDT_NODE DT_INVALID_NODE
#endif

#if DT_NODE_EXISTS(WDT_NODE)
static const struct device *const wdt_dev = DEVICE_DT_GET(WDT_NODE);
#else
static const struct device *const wdt_dev = NULL;
#endif

static int wdt_channel_id = -1;
static struct k_work_delayable wdt_feed_work;

static void wdt_feed_handler(struct k_work *work)
{
    if (wdt_channel_id >= 0 && wdt_dev) {
        (void)wdt_feed(wdt_dev, wdt_channel_id);
    }
    /* Feed roughly every half-timeout for margin */
    k_work_reschedule(&wdt_feed_work, K_MSEC(CONFIG_APP_WDT_TIMEOUT_MS / 2));
}

int watchdog_init(void)
{
    if (!wdt_dev) {
        LOG_WRN("No watchdog device node found");
        return -ENODEV;
    }
    if (!device_is_ready(wdt_dev)) {
        LOG_ERR("Watchdog device not ready");
        return -ENODEV;
    }

    static struct wdt_timeout_cfg cfg = {
        .window = {
            .min = 0,
            .max = CONFIG_APP_WDT_TIMEOUT_MS,
        },
        .flags = WDT_FLAG_RESET_SOC, /* ensure SoC reset on timeout */
        .callback = NULL,           /* no interrupt callback, let it reset */
    };

    wdt_channel_id = wdt_install_timeout(wdt_dev, &cfg);
    if (wdt_channel_id < 0) {
        LOG_ERR("wdt_install_timeout failed (%d)", wdt_channel_id);
        return wdt_channel_id;
    }

    int err = wdt_setup(wdt_dev, WDT_OPT_PAUSE_HALTED_BY_DBG);
    if (err) {
        LOG_ERR("wdt_setup failed (%d)", err);
        return err;
    }

    k_work_init_delayable(&wdt_feed_work, wdt_feed_handler);
    /* Start feeding right away */
    k_work_reschedule(&wdt_feed_work, K_NO_WAIT);
    LOG_INF("Watchdog started: %d ms", CONFIG_APP_WDT_TIMEOUT_MS);
    return 0;
}

#else /* watchdog disabled or not supported */

int watchdog_init(void)
{
    return 0;
}

#endif
```
