## CMakeLists.txt
```
# SPDX-License-Identifier: Apache-2.0

cmake_minimum_required(VERSION 3.20.0)

find_package(Zephyr REQUIRED HINTS $ENV{ZEPHYR_BASE})
project(ble_battery_sample)

target_sources(app PRIVATE
    src/main.c
    src/battery_service.c
)
```

## Kconfig
```
# Copyright (c) 2024
# SPDX-License-Identifier: Apache-2.0

mainmenu "BLE Battery Monitor Application"

source "Kconfig.zephyr"
```

## sample.yaml
```
sample:
  name: BLE Battery Monitor with Custom Service
  description: Bluetooth Low Energy application with custom 128-bit service for battery monitoring
common:
  harness: bluetooth
  platform_allow: nrf52840dk_nrf52840 nrf5340dk_nrf5340_cpuapp nrf52dk_nrf52832
  integration_platforms:
    - nrf52840dk_nrf52840
  tags: bluetooth ble
```

## prj.conf
```kconfig
# Bluetooth configuration
CONFIG_BT=y
CONFIG_BT_PERIPHERAL=y
CONFIG_BT_DEVICE_NAME="Battery Monitor"
CONFIG_BT_DEVICE_NAME_DYNAMIC=n
CONFIG_BT_DEVICE_NAME_MAX=20

# Enable BLE GAP and GATT
CONFIG_BT_GATT_DYNAMIC_DB=y

# Enable BT settings
CONFIG_BT_SETTINGS=y
CONFIG_FLASH=y
CONFIG_FLASH_MAP=y
CONFIG_NVS=y
CONFIG_SETTINGS=y

# ADC for battery measurement
CONFIG_ADC=y

# Logging
CONFIG_LOG=y
CONFIG_LOG_DEFAULT_LEVEL=3
CONFIG_BT_DEBUG_LOG=y
```

## src/main.c
```c
/*
 * Copyright (c) 2024
 * SPDX-License-Identifier: Apache-2.0
 */

#include <zephyr/kernel.h>
#include <zephyr/bluetooth/bluetooth.h>
#include <zephyr/bluetooth/hci.h>
#include <zephyr/bluetooth/conn.h>
#include <zephyr/bluetooth/uuid.h>
#include <zephyr/bluetooth/gatt.h>
#include <zephyr/drivers/adc.h>
#include <zephyr/logging/log.h>

#include "battery_service.h"

LOG_MODULE_REGISTER(main, LOG_LEVEL_INF);

/* Advertising data */
static const struct bt_data ad[] = {
	BT_DATA_BYTES(BT_DATA_FLAGS, (BT_LE_AD_GENERAL | BT_LE_AD_NO_BREDR)),
	/* Custom 128-bit Service UUID: 12345678-1234-5678-1234-56789abcdef0 (little-endian) */
	BT_DATA_BYTES(BT_DATA_UUID128_ALL,
		      0xf0, 0xde, 0xbc, 0x9a, 0x78, 0x56, 0x34, 0x12,
		      0x34, 0x12, 0x78, 0x56, 0x34, 0x12, 0x78, 0x56),
};

/* Scan response data */
static const struct bt_data sd[] = {
	BT_DATA(BT_DATA_NAME_COMPLETE, CONFIG_BT_DEVICE_NAME, sizeof(CONFIG_BT_DEVICE_NAME) - 1),
};

/* Connection callback handlers */
static void connected(struct bt_conn *conn, uint8_t err)
{
	char addr[BT_ADDR_LE_STR_LEN];
	
	if (err) {
		LOG_ERR("Connection failed (err %u)", err);
		return;
	}
	
	bt_addr_le_to_str(bt_conn_get_dst(conn), addr, sizeof(addr));
	LOG_INF("Connected: %s", addr);
}

static void disconnected(struct bt_conn *conn, uint8_t reason)
{
	char addr[BT_ADDR_LE_STR_LEN];
	
	bt_addr_le_to_str(bt_conn_get_dst(conn), addr, sizeof(addr));
	LOG_INF("Disconnected: %s (reason %u)", addr, reason);
}

BT_CONN_CB_DEFINE(conn_callbacks) = {
	.connected = connected,
	.disconnected = disconnected,
};

/* Simulated battery voltage measurement */
static uint16_t simulate_battery_voltage(void)
{
	/* Simulate battery voltage between 3.0V and 4.2V */
	static uint16_t voltage = 4200;
	static int8_t direction = -1;
	
	voltage += (direction * 10);
	
	if (voltage <= 3000) {
		direction = 1;
		voltage = 3000;
	} else if (voltage >= 4200) {
		direction = -1;
		voltage = 4200;
	}
	
	return voltage;
}

/* Battery monitoring thread */
void battery_monitor_thread(void)
{
	LOG_INF("Battery monitoring thread started");
	
	while (1) {
		uint32_t interval_ms = battery_service_get_interval();
		uint16_t voltage_mv;
		
		/* Simulate battery voltage measurement */
		voltage_mv = simulate_battery_voltage();
		
		/* Update the characteristic */
		battery_service_update_voltage(voltage_mv);
		
		LOG_INF("Battery voltage: %u mV (interval: %u ms)", voltage_mv, interval_ms);
		
		/* Sleep for the configured interval */
		k_msleep(interval_ms);
	}
}

K_THREAD_DEFINE(battery_monitor_tid, 1024,
		battery_monitor_thread, NULL, NULL, NULL,
		7, 0, 0);

int main(void)
{
	int err;
	
	LOG_INF("Starting Bluetooth Low Energy Battery Monitor");
	LOG_INF("NCS version: 3.1.1");
	
	/* Initialize the Bluetooth Subsystem */
	err = bt_enable(NULL);
	if (err) {
		LOG_ERR("Bluetooth init failed (err %d)", err);
		return err;
	}
	
	LOG_INF("Bluetooth initialized");
	
	/* Initialize the battery service */
	err = battery_service_init();
	if (err) {
		LOG_ERR("Battery service init failed (err %d)", err);
		return err;
	}
	
	/* Start advertising */
	err = bt_le_adv_start(BT_LE_ADV_CONN, ad, ARRAY_SIZE(ad), sd, ARRAY_SIZE(sd));
	if (err) {
		LOG_ERR("Advertising failed to start (err %d)", err);
		return err;
	}
	
	LOG_INF("Advertising successfully started");
	LOG_INF("Device name: %s", CONFIG_BT_DEVICE_NAME);
	
	return 0;
}
```

## src/battery_service.c
```c
/*
 * Copyright (c) 2024
 * SPDX-License-Identifier: Apache-2.0
 */

#include <zephyr/kernel.h>
#include <zephyr/bluetooth/bluetooth.h>
#include <zephyr/bluetooth/uuid.h>
#include <zephyr/bluetooth/gatt.h>
#include <zephyr/logging/log.h>

#include "battery_service.h"

LOG_MODULE_REGISTER(battery_service, LOG_LEVEL_DBG);

/* Custom 128-bit UUID for Battery Monitor Service */
#define BT_UUID_BATTERY_MONITOR_SERVICE_VAL \
	BT_UUID_128_ENCODE(0x12345678, 0x1234, 0x5678, 0x1234, 0x56789abcdef0)

/* Battery Voltage Characteristic UUID */
#define BT_UUID_BATTERY_VOLTAGE_VAL \
	BT_UUID_128_ENCODE(0x12345678, 0x1234, 0x5678, 0x1234, 0x56789abcdef1)

/* Sample Interval Characteristic UUID */
#define BT_UUID_SAMPLE_INTERVAL_VAL \
	BT_UUID_128_ENCODE(0x12345678, 0x1234, 0x5678, 0x1234, 0x56789abcdef2)

#define BT_UUID_BATTERY_MONITOR_SERVICE \
	BT_UUID_DECLARE_128(BT_UUID_BATTERY_MONITOR_SERVICE_VAL)
#define BT_UUID_BATTERY_VOLTAGE \
	BT_UUID_DECLARE_128(BT_UUID_BATTERY_VOLTAGE_VAL)
#define BT_UUID_SAMPLE_INTERVAL \
	BT_UUID_DECLARE_128(BT_UUID_SAMPLE_INTERVAL_VAL)

/* Service characteristics data */
static uint16_t battery_voltage_mv = 3300; /* Default 3.3V */
static uint32_t sample_interval_ms = 1000; /* Default 1 second */

/* GATT attribute indices */
enum {
	BATTERY_MONITOR_GATT_IDX_SVC,
	BATTERY_MONITOR_GATT_IDX_VOLTAGE_CHAR,
	BATTERY_MONITOR_GATT_IDX_VOLTAGE_VAL,
	BATTERY_MONITOR_GATT_IDX_VOLTAGE_CCC,
	BATTERY_MONITOR_GATT_IDX_INTERVAL_CHAR,
	BATTERY_MONITOR_GATT_IDX_INTERVAL_VAL,
	BATTERY_MONITOR_GATT_IDX_INTERVAL_CCC,
	BATTERY_MONITOR_GATT_IDX_COUNT,
};

/* Forward declarations */
static ssize_t read_voltage(struct bt_conn *conn, const struct bt_gatt_attr *attr,
			    void *buf, uint16_t len, uint16_t offset);
static ssize_t read_interval(struct bt_conn *conn, const struct bt_gatt_attr *attr,
			     void *buf, uint16_t len, uint16_t offset);
static ssize_t write_interval(struct bt_conn *conn, const struct bt_gatt_attr *attr,
			      const void *buf, uint16_t len, uint16_t offset, uint8_t flags);
static void voltage_ccc_cfg_changed(const struct bt_gatt_attr *attr, uint16_t value);
static void interval_ccc_cfg_changed(const struct bt_gatt_attr *attr, uint16_t value);

/* Battery Monitor Service Declaration */
BT_GATT_SERVICE_DEFINE(battery_monitor_svc,
	BT_GATT_PRIMARY_SERVICE(BT_UUID_BATTERY_MONITOR_SERVICE),
	
	/* Battery Voltage Characteristic */
	BT_GATT_CHARACTERISTIC(BT_UUID_BATTERY_VOLTAGE,
			       BT_GATT_CHRC_READ | BT_GATT_CHRC_NOTIFY,
			       BT_GATT_PERM_READ,
			       read_voltage, NULL, &battery_voltage_mv),
	BT_GATT_CCC(voltage_ccc_cfg_changed, BT_GATT_PERM_READ | BT_GATT_PERM_WRITE),
	
	/* Sample Interval Characteristic */
	BT_GATT_CHARACTERISTIC(BT_UUID_SAMPLE_INTERVAL,
			       BT_GATT_CHRC_READ | BT_GATT_CHRC_WRITE | BT_GATT_CHRC_NOTIFY,
			       BT_GATT_PERM_READ | BT_GATT_PERM_WRITE,
			       read_interval, write_interval, &sample_interval_ms),
	BT_GATT_CCC(interval_ccc_cfg_changed, BT_GATT_PERM_READ | BT_GATT_PERM_WRITE),
);

/* Read battery voltage characteristic */
static ssize_t read_voltage(struct bt_conn *conn, const struct bt_gatt_attr *attr,
			    void *buf, uint16_t len, uint16_t offset)
{
	uint16_t voltage = battery_voltage_mv;
	
	LOG_DBG("Battery voltage read: %u mV", voltage);
	
	return bt_gatt_attr_read(conn, attr, buf, len, offset, &voltage, sizeof(voltage));
}

/* Read sample interval characteristic */
static ssize_t read_interval(struct bt_conn *conn, const struct bt_gatt_attr *attr,
			     void *buf, uint16_t len, uint16_t offset)
{
	uint32_t interval = sample_interval_ms;
	
	LOG_DBG("Sample interval read: %u ms", interval);
	
	return bt_gatt_attr_read(conn, attr, buf, len, offset, &interval, sizeof(interval));
}

/* Write sample interval characteristic */
static ssize_t write_interval(struct bt_conn *conn, const struct bt_gatt_attr *attr,
			      const void *buf, uint16_t len, uint16_t offset, uint8_t flags)
{
	uint32_t new_interval;
	
	if (offset != 0) {
		return BT_GATT_ERR(BT_ATT_ERR_INVALID_OFFSET);
	}
	
	if (len != sizeof(new_interval)) {
		return BT_GATT_ERR(BT_ATT_ERR_INVALID_ATTRIBUTE_LEN);
	}
	
	memcpy(&new_interval, buf, sizeof(new_interval));
	
	/* Validate interval (min 100ms, max 60s) */
	if (new_interval < 100 || new_interval > 60000) {
		LOG_WRN("Invalid sample interval: %u ms", new_interval);
		return BT_GATT_ERR(BT_ATT_ERR_VALUE_NOT_ALLOWED);
	}
	
	sample_interval_ms = new_interval;
	LOG_INF("Sample interval updated to: %u ms", sample_interval_ms);
	
	return len;
}

/* CCC changed callback for voltage characteristic */
static void voltage_ccc_cfg_changed(const struct bt_gatt_attr *attr, uint16_t value)
{
	bool notif_enabled = (value == BT_GATT_CCC_NOTIFY);
	
	LOG_INF("Battery voltage notifications %s", notif_enabled ? "enabled" : "disabled");
}

/* CCC changed callback for interval characteristic */
static void interval_ccc_cfg_changed(const struct bt_gatt_attr *attr, uint16_t value)
{
	bool notif_enabled = (value == BT_GATT_CCC_NOTIFY);
	
	LOG_INF("Sample interval notifications %s", notif_enabled ? "enabled" : "disabled");
}

int battery_service_init(void)
{
	LOG_INF("Battery Monitor Service initialized");
	LOG_INF("Service UUID: 12345678-1234-5678-1234-56789abcdef0");
	LOG_INF("Voltage Char UUID: 12345678-1234-5678-1234-56789abcdef1");
	LOG_INF("Interval Char UUID: 12345678-1234-5678-1234-56789abcdef2");
	
	return 0;
}

int battery_service_update_voltage(uint16_t voltage_mv)
{
	int err;
	
	battery_voltage_mv = voltage_mv;
	
	LOG_DBG("Updating battery voltage to: %u mV", voltage_mv);
	
	err = bt_gatt_notify(NULL, &battery_monitor_svc.attrs[BATTERY_MONITOR_GATT_IDX_VOLTAGE_VAL],
			     &battery_voltage_mv, sizeof(battery_voltage_mv));
	if (err && err != -ENOTCONN) {
		LOG_ERR("Failed to send voltage notification: %d", err);
		return err;
	}
	
	return 0;
}

int battery_service_update_interval(uint32_t interval_ms)
{
	int err;
	
	sample_interval_ms = interval_ms;
	
	LOG_DBG("Updating sample interval to: %u ms", interval_ms);
	
	err = bt_gatt_notify(NULL, &battery_monitor_svc.attrs[BATTERY_MONITOR_GATT_IDX_INTERVAL_VAL],
			     &sample_interval_ms, sizeof(sample_interval_ms));
	if (err && err != -ENOTCONN) {
		LOG_ERR("Failed to send interval notification: %d", err);
		return err;
	}
	
	return 0;
}

uint32_t battery_service_get_interval(void)
{
	return sample_interval_ms;
}
```

## src/battery_service.h
```c
/*
 * Copyright (c) 2024
 * SPDX-License-Identifier: Apache-2.0
 */

#ifndef BATTERY_SERVICE_H_
#define BATTERY_SERVICE_H_

#include <zephyr/types.h>

#ifdef __cplusplus
extern "C" {
#endif

/**
 * @brief Initialize the custom battery service
 *
 * @return 0 on success, negative errno code on failure
 */
int battery_service_init(void);

/**
 * @brief Update battery voltage characteristic
 *
 * @param voltage_mv Battery voltage in millivolts
 * @return 0 on success, negative errno code on failure
 */
int battery_service_update_voltage(uint16_t voltage_mv);

/**
 * @brief Update sample interval characteristic
 *
 * @param interval_ms Sample interval in milliseconds
 * @return 0 on success, negative errno code on failure
 */
int battery_service_update_interval(uint32_t interval_ms);

/**
 * @brief Get current sample interval
 *
 * @return Current sample interval in milliseconds
 */
uint32_t battery_service_get_interval(void);

#ifdef __cplusplus
}
#endif

#endif /* BATTERY_SERVICE_H_ */
```
